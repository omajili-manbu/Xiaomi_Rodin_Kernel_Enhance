## drivers/dma-buf/heaps/Kconfig
```kconfig
config DMABUF_HEAPS_PAGE_POOL
	bool "DMA-BUF heaps page-pool library"
	default y
	depends on DMABUF_HEAPS
	help
	  rodin r12: 6.6 设备树的 DMABUF heaps page-pool 库。预编译的
	  mtk_sec_heap.ko / mtk_heap_refill.ko 导入其 dmabuf_page_pool_* 导出，
	  6.18 移植时整个文件丢了，这里补回。

config DMABUF_HEAPS_SYSTEM
	tristate "DMA-BUF System Heap"
	depends on DMABUF_HEAPS
	help
	  Choose this option to enable the system dmabuf heap. The system heap
	  is backed by pages from the buddy allocator. If in doubt, say Y.

config DMABUF_HEAPS_CMA
	tristate "DMA-BUF CMA Heap"
	depends on DMABUF_HEAPS && DMA_CMA
	help
	  Choose this option to enable dma-buf CMA heap. This heap is backed
	  by the Contiguous Memory Allocator (CMA). If your system has these
	  regions, you should say Y here.

config DMABUF_HEAPS_CMA_LEGACY
	bool "Legacy DMA-BUF CMA Heap"
	default y
	depends on DMABUF_HEAPS_CMA
	help
	  Add a duplicate CMA-backed dma-buf heap with legacy naming derived
	  from the CMA area's devicetree node, or "reserved" if the area is not
	  defined in the devicetree. This uses the same underlying allocator as
	  CONFIG_DMABUF_HEAPS_CMA.
```
